## CMakeLists.txt
```
# SPDX-License-Identifier: Apache-2.0

cmake_minimum_required(VERSION 3.20.0)
find_package(Zephyr REQUIRED HINTS $ENV{ZEPHYR_BASE})
project(flowteal-magi-sensor-gateway-zephyr)

target_sources(app PRIVATE src/main.c)

target_sources(app PRIVATE src/sockets.c)
target_sources(app PRIVATE src/wifi.c)

target_sources(app PRIVATE src/lora.c)

#target_sources(app PRIVATE src/display.c)
```

## Kconfig
```
mainmenu "Flowteal Magi Sensors Gateway"

menu "Flowteal Magi Sensors Gateway"

config SPRINKLER_MANUAL_SERVER
	bool "Disable DNS lookup"

config SPRINKLER_API_SERVER_IP
	string "TagoIO Main Server"
	depends on SPRINKLER_MANUAL_SERVER
	default "75.2.65.153"

config SPRINKLER_DEVICE_TOKEN
	string "The Device Identification Token"
	default "device_token"

config SPRINKLER_HTTP_PUSH_INTERVAL
	int "Configure data push interval in seconds"
	range 1 512
	default 10

config SPRINKLER_HTTP_CONN_TIMEOUT
	int "Configure http request timeout in seconds"
	range 1 120
	default 10

if WIFI

config SPRINKLER_HTTP_WIFI_SSID
	string "WIFI SSID - Network name"
	default "my_network"

config SPRINKLER_HTTP_WIFI_PSK
	string "WIFI PSK - Network password key"
	default "secret_passwd"

endif # WIFI

module = SPRINKLER_HTTP_POST
module-str = Flowteal Magi Sensors Gateway
module-help = Reads from sensors and controls irrigation programmer
source "subsys/logging/Kconfig.template.log_config"

endmenu

source "Kconfig.zephyr"
```

## prj.conf
```kconfig
# App stack
CONFIG_MAIN_STACK_SIZE=4096

# C Library
# Default use minimal libc and with MINIMAL_LIBC_MALLOC_ARENA_SIZE defining
# HEAP size (512 bytes) are enough to run DNS.
CONFIG_MINIMAL_LIBC_MALLOC_ARENA_SIZE=4096

# Logging and printing
CONFIG_LOG=y
CONFIG_PRINTK=y
CONFIG_CBPRINTF_FP_SUPPORT=y

# Networking config
CONFIG_NETWORKING=y
CONFIG_NET_IPV4=y
CONFIG_NET_IPV6=n
CONFIG_NET_TCP=y
CONFIG_NET_SHELL=y

# Sockets
CONFIG_NET_SOCKETS=y
CONFIG_NET_SOCKETS_POSIX_NAMES=y
CONFIG_NET_SOCKETS_POLL_MAX=4

# Network driver config
CONFIG_TEST_RANDOM_GENERATOR=y

# Network address config
CONFIG_NET_CONFIG_SETTINGS=y
CONFIG_NET_CONFIG_NEED_IPV4=y
CONFIG_NET_DHCPV4=y

# Resolver
CONFIG_DNS_RESOLVER=y

# HTTP
CONFIG_HTTP_CLIENT=y

# Network debug config
CONFIG_LOG=y
CONFIG_NET_LOG=y
CONFIG_NET_SOCKETS_LOG_LEVEL_DBG=n
CONFIG_NET_HTTP_LOG_LEVEL_DBG=n

# Sprinkler API
CONFIG_SPRINKLER_DEVICE_TOKEN="bed027b1-95d2-48de-a181-bbc9dcbeeecc"
CONFIG_CBPRINTF_FP_SUPPORT=y

# WiFi
CONFIG_WIFI=y
# WiFi offload drivers don't resolve DNS, so use manual IP
CONFIG_SPRINKLER_MANUAL_SERVER=y
CONFIG_NET_CONFIG_SETTINGS=y
CONFIG_NET_DHCPV4=y
CONFIG_NET_MGMT_EVENT=y
CONFIG_NETWORKING=y
CONFIG_NET_MGMT_EVENT_INFO=y
CONFIG_NET_L2_WIFI_MGMT=y

# LoRa
CONFIG_SPI=y
CONFIG_GPIO=y
CONFIG_LORA=y
CONFIG_LORA_SX12XX=y

# JSON
CONFIG_JSON_LIBRARY=y

# Display // TODO: app crashes at runtime when adding display confs (Heltec)
# CONFIG_DISPLAY=y
# CONFIG_DISPLAY_LOG_LEVEL_ERR=y

# LVGL graphics // TODO: app crashes at runtime when adding display confs (Heltec)
# CONFIG_LVGL=y
# CONFIG_LV_MEM_CUSTOM=y
# CONFIG_LV_USE_LOG=y
# CONFIG_LV_USE_LABEL=y
# CONFIG_LV_USE_BTN=y
# CONFIG_LV_USE_IMG=y
# CONFIG_LV_FONT_MONTSERRAT_14=y
# CONFIG_LV_Z_MEM_POOL_NUMBER_BLOCKS=8
```

## overlay-wifi.conf
```kconfig
CONFIG_WIFI=y
# WiFi offload drivers don't resolve DNS, so use manual IP
CONFIG_TAGOIO_MANUAL_SERVER=y
#CONFIG_TAGOIO_HTTP_WIFI_SSID="INCUBATORE"
#CONFIG_TAGOIO_HTTP_WIFI_PSK="#openthefuture@2040*"
CONFIG_TAGOIO_HTTP_WIFI_SSID="UMARELL"
CONFIG_TAGOIO_HTTP_WIFI_PSK="ledvespv"

CONFIG_NET_CONFIG_SETTINGS=y
CONFIG_NET_DHCPV4=y
CONFIG_NET_MGMT_EVENT=y
CONFIG_NETWORKING=y
CONFIG_NET_MGMT_EVENT_INFO=y
CONFIG_NET_L2_WIFI_MGMT=y
```

## boards/heltec_wifi_lora32_v2.conf
```kconfig
CONFIG_WIFI=y
CONFIG_HEAP_MEM_POOL_SIZE=98304

CONFIG_NETWORKING=y
CONFIG_NET_L2_ETHERNET=y

CONFIG_NET_IPV6=n
CONFIG_NET_IPV4=y
CONFIG_NET_DHCPV4=y

CONFIG_NET_LOG=y
```

## src/main.c
```c
#include <zephyr/logging/log.h>
LOG_MODULE_REGISTER(flowteal_magi_sensors_gateway, CONFIG_SPRINKLER_HTTP_POST_LOG_LEVEL);

#include <zephyr/kernel.h>
#include <zephyr/net/socket.h>
#include <zephyr/net/http/client.h>
#include <zephyr/random/rand32.h>
#include <stdio.h>

#include "wifi.h"
#include "sockets.h"
//#include "display.h" // TODO: app crashes at runtime when adding display confs (Heltec)
#include "lora.h"
#include "moisture_data.h"

static struct sprinkler_context ctx;

static int cnt = 0;

static struct moisture moisture_json;

#define DEFAULT_RADIO_NODE DT_ALIAS(lora0)
BUILD_ASSERT(DT_NODE_HAS_STATUS(DEFAULT_RADIO_NODE, okay),
	     "No default LoRa radio specified in DT");

static void response_cb(struct http_response *rsp,
			enum http_final_call final_data,
			void *user_data)
{
	if (final_data == HTTP_DATA_MORE) {
		LOG_DBG("Partial data received (%zd bytes)", rsp->data_len);
	} else if (final_data == HTTP_DATA_FINAL) {
		LOG_DBG("All the data received (%zd bytes)", rsp->data_len);
	}

	LOG_DBG("Response status %s", rsp->http_status);
}

static int collect_data(void)
{
	#define lower 20000
	#define upper 100000
	#define base  1000.00f

	float temp;

	/* Generate a temperature between 20 and 100 celsius degree */
	temp = ((sys_rand32_get() % (upper - lower + 1)) + lower);
	temp /= base;

	(void)snprintf(ctx.payload, sizeof(ctx.payload),
		       "{\"variable\": \"temperature\","
		       "\"unit\": \"c\",\"value\": %f}",
		       (double)temp);

	/* LOG doesn't print float #18351 */
	LOG_INF("Temp: %d", (int) temp);

	return 0;
}

static void next_turn(void)
{
	if (collect_data() < 0) {
		LOG_INF("Error collecting data.");
		return;
	}

	if (sprinkler_connect(&ctx) < 0) {
		LOG_INF("No connection available.");
		return;
	}

	if (sprinkler_http_push(&ctx, response_cb) < 0) {
		LOG_INF("Error pushing data.");
		return;
	}
}

void decode_moisture_info(const struct device *dev, uint8_t *data, uint16_t size,
		     int16_t rssi, int8_t snr)
{
	ARG_UNUSED(dev);
	LOG_INF("Message received (RSSI:%ddBm, SNR:%ddBm)",
		rssi, snr);

	// Copy "data" since first 2 chars and last char are always junk
 	size_t start = 2;
	size_t end = -1;
	size_t size_proc = size-start+end;
	char data_processed[size_proc];
	for(size_t i = 0; i < size_proc; i++ )
    	strcpy(data_processed+i,(char*)data+start+i+2);
	data_processed[size_proc] = '\0';

	int ret = json_obj_parse(data_processed, size_proc,
                moisture_descr,
                ARRAY_SIZE(moisture_descr),
                &moisture_json);

	if (ret < 0)
	{
		LOG_ERR("JSON Parse Error: %d", ret);
	}
	else if (ret != expected_ret_code)
	{
		LOG_ERR("Not all values decoded; Expected return code %d but got %d", expected_ret_code, ret);
	}
	else
	{
		LOG_INF("json_obj_parse return code: %d", ret);
		LOG_INF("sid: %s", moisture_json.sid);
		LOG_INF("msgid: %d", moisture_json.msgid);
		// LOG_INF("adc: %d", moisture_json.adc);
		// LOG_INF("V: %d", moisture_json.V);
		LOG_INF("vwc: %d", moisture_json.vwc);
	}

	++cnt;
	//strncpy(sensor_str, moisture_json.sid, SID_UI_LEN);
	//lv_label_set_text_fmt(ui_label_top, "sid: %s", sensor_str);
	//lv_label_set_text_fmt(ui_label_mid, "msgid: %d", moisture_json.msgid);
	//lv_label_set_text_fmt(ui_label_bottom, "vwc: %de-2", moisture_json.vwc);
	//lv_task_handler();
	sprinkler_http_push(&ctx, response_cb);
}

void main(void)
{
	LOG_INF("Flowteal Magi - Sensors gateway");

	//display_init();  // TODO: app crashes at runtime when adding display confs (Heltec)

	const struct device *const lora_dev = DEVICE_DT_GET(DEFAULT_RADIO_NODE);
	lora_setup(lora_dev);

	wifi_connect();

	// while (true) {
	// 	next_turn();

	// 	k_sleep(K_SECONDS(CONFIG_SPRINKLER_HTTP_PUSH_INTERVAL));
	// }

	LOG_INF("Asynchronous reception");
	lora_recv_async(lora_dev, decode_moisture_info);
	k_sleep(K_FOREVER);
}
```

## src/display.c
```c
#include <zephyr/logging/log.h>
LOG_MODULE_DECLARE(flowteal_magi_sensors_gateway, CONFIG_SPRINKLER_HTTP_POST_LOG_LEVEL);

#include <zephyr/drivers/display.h>
#include <lvgl.h>

#include "display.h"

lv_obj_t *ui_label_top;
lv_obj_t *ui_label_mid;
lv_obj_t *ui_label_bottom;

void display_init(void) {
    const struct device *display_dev;

	display_dev = DEVICE_DT_GET(DT_CHOSEN(zephyr_display));
	if (!device_is_ready(display_dev)) {
		LOG_ERR("Device not ready, aborting test");
		return;
	}

    ui_label_top = lv_label_create(lv_scr_act());
	lv_obj_align(ui_label_top, LV_ALIGN_TOP_MID, 0, 0);
	lv_label_set_text(ui_label_top, "[latest sensor]");

	ui_label_mid = lv_label_create(lv_scr_act());
	lv_obj_align(ui_label_mid, LV_ALIGN_CENTER, 0, 0);
	lv_label_set_text(ui_label_mid, "[message id]");

	ui_label_bottom = lv_label_create(lv_scr_act());
	lv_obj_align(ui_label_bottom, LV_ALIGN_BOTTOM_MID, 0, 0);
	lv_label_set_text(ui_label_bottom, "[Vol Water Cont]");

	lv_task_handler();
}
```

## src/lora.c
```c
#include <zephyr/logging/log.h>
LOG_MODULE_DECLARE(flowteal_magi_sensors_gateway, CONFIG_SPRINKLER_HTTP_POST_LOG_LEVEL);

#include "lora.h"

#define MAX_DATA_LEN 255

void lora_setup(const struct device *lora_dev) {
    // LORA
	//const struct device *const lora_dev = DEVICE_DT_GET(DEFAULT_RADIO_NODE);
	struct lora_modem_config config;
	int ret, len;
	uint8_t data[MAX_DATA_LEN] = {0};
	int16_t rssi;
	int8_t snr;

	if (!device_is_ready(lora_dev)) {
		LOG_ERR("%s Device not ready", lora_dev->name);
		return;
	}

	config.frequency = 868000000;
	config.bandwidth = BW_125_KHZ;
	config.datarate = SF_9;
	config.preamble_len = 8;
	config.coding_rate = CR_4_5;
	config.iq_inverted = false;
	config.public_network = false;
	config.tx_power = 14;
	config.tx = false;

	ret = lora_config(lora_dev, &config);
	if (ret < 0) {
		LOG_ERR("LoRa config failed");
		return;
	}
}
```

## src/lora.h
```c
#include <zephyr/drivers/lora.h>
void lora_setup(const struct device *lora_dev);
```

## src/moisture_data.h
```c
#include <zephyr/data/json.h>

struct moisture {
	char *sid;
	int msgid;
	int adc;
	int V;
	int vwc;
	};
struct json_obj_descr moisture_descr[] = {
	JSON_OBJ_DESCR_PRIM(struct moisture, sid, JSON_TOK_STRING),
	JSON_OBJ_DESCR_PRIM(struct moisture, msgid, JSON_TOK_NUMBER),
	//JSON_OBJ_DESCR_PRIM(struct moisture, adc, JSON_TOK_NUMBER), 
	//JSON_OBJ_DESCR_PRIM(struct moisture, V, JSON_TOK_NUMBER), 
	JSON_OBJ_DESCR_PRIM(struct moisture, vwc, JSON_TOK_NUMBER)
	};


int expected_ret_code = (1 << ARRAY_SIZE(moisture_descr)) - 1;
```

## src/sockets.c
```c
#include <zephyr/logging/log.h>
LOG_MODULE_DECLARE(flowteal_magi_sensors_gateway, CONFIG_SPRINKLER_HTTP_POST_LOG_LEVEL);

#include <zephyr/net/net_ip.h>
#include <zephyr/net/socket.h>
#include <zephyr/net/socketutils.h>
#include <zephyr/net/dns_resolve.h>
#include <zephyr/net/tls_credentials.h>
#include <zephyr/net/http/client.h>

#include "sockets.h"

#if IS_ENABLED(CONFIG_SPRINKLER_MANUAL_SERVER)
#define SPRINKLER_SERVER CONFIG_SPRINKLER_API_SERVER_IP
#else
#define SPRINKLER_SERVER "api.tago.io"
#endif

#define SPRINKLER_URL          "/data"
#define HTTP_PORT           "80"

static const char *sprinkler_http_headers[] = {
	"Device-Token: " CONFIG_SPRINKLER_DEVICE_TOKEN "\r\n",
	"Content-Type: application/json\r\n",
	"_ssl: false\r\n",
	NULL
};

int sprinkler_connect(struct sprinkler_context *ctx)
{
	struct addrinfo *addr;
	struct addrinfo hints;
	char hr_addr[INET6_ADDRSTRLEN];
	char *port;
	int dns_attempts = 3;
	int ret = -1;

	memset(&hints, 0, sizeof(hints));

	hints.ai_socktype = SOCK_STREAM;
	hints.ai_protocol = IPPROTO_TCP;
	if (IS_ENABLED(CONFIG_NET_IPV6)) {
		hints.ai_family = AF_INET6;
	} else if (IS_ENABLED(CONFIG_NET_IPV4)) {
		hints.ai_family = AF_INET;
	}
	port = HTTP_PORT;

	while (dns_attempts--) {
		ret = getaddrinfo(SPRINKLER_SERVER, port, &hints, &addr);
		if (ret == 0) {
			break;
		}
		k_sleep(K_SECONDS(1));
	}

	if (ret < 0) {
		LOG_ERR("Could not resolve dns, error: %d", ret);
		return ret;
	}

	LOG_DBG("%s address: %s",
		(addr->ai_family == AF_INET ? "IPv4" : "IPv6"),
		net_addr_ntop(addr->ai_family,
			      &net_sin(addr->ai_addr)->sin_addr,
			      hr_addr, sizeof(hr_addr)));

	ctx->sock = socket(hints.ai_family,
			   hints.ai_socktype,
			   hints.ai_protocol);
	if (ctx->sock < 0) {
		LOG_ERR("Failed to create %s HTTP socket (%d)",
			(addr->ai_family == AF_INET ? "IPv4" : "IPv6"),
			-errno);

		freeaddrinfo(addr);
		return -errno;
	}

	if (connect(ctx->sock, addr->ai_addr, addr->ai_addrlen) < 0) {
		LOG_ERR("Cannot connect to %s remote (%d)",
			(addr->ai_family == AF_INET ? "IPv4" : "IPv6"),
			-errno);

		freeaddrinfo(addr);
		return -errno;
	}

	freeaddrinfo(addr);

	return 0;
}

int sprinkler_http_push(struct sprinkler_context *ctx,
		     http_response_cb_t resp_cb)
{
	struct http_request req;
	int ret;

	memset(&req, 0, sizeof(req));

	req.method		= HTTP_POST;
	req.host		= SPRINKLER_SERVER;
	req.port		= HTTP_PORT;
	req.url			= SPRINKLER_URL;
	req.header_fields	= sprinkler_http_headers;
	req.protocol		= "HTTP/1.1";
	req.response		= resp_cb;
	req.payload		= ctx->payload;
	req.payload_len		= strlen(ctx->payload);
	req.recv_buf		= ctx->resp;
	req.recv_buf_len	= sizeof(ctx->resp);

	ret = http_client_req(ctx->sock, &req,
			      CONFIG_SPRINKLER_HTTP_CONN_TIMEOUT * MSEC_PER_SEC,
			      ctx);

	close(ctx->sock);
	ctx->sock = -1;

	return ret;
}
```

## src/sockets.h
```c
#define SPRINKLER_SOCKET_MAX_BUF_LEN 1280

struct sprinkler_context {
	int sock;
	uint8_t payload[SPRINKLER_SOCKET_MAX_BUF_LEN];
	uint8_t resp[SPRINKLER_SOCKET_MAX_BUF_LEN];
};

int sprinkler_connect(struct sprinkler_context *ctx);
int sprinkler_http_push(struct sprinkler_context *ctx,
		     http_response_cb_t resp_cb);
```

## src/wifi.c
```c
#include <zephyr/logging/log.h>
LOG_MODULE_DECLARE(flowteal_magi_sensors_gateway, CONFIG_SPRINKLER_HTTP_POST_LOG_LEVEL);

#include <zephyr/net/wifi_mgmt.h>

#include "wifi.h"

static int connected;
static struct net_mgmt_event_callback wifi_shell_mgmt_cb;

static void handle_wifi_connect_result(struct net_mgmt_event_callback *cb)
{
	const struct wifi_status *status = (const struct wifi_status *)
					   cb->info;

	if (status->status) {
		LOG_ERR("Connection request failed (%d)", status->status);
	} else {
		LOG_INF("WIFI Connected");
		connected = 1;
	}
}

static void wifi_mgmt_event_handler(struct net_mgmt_event_callback *cb,
				    uint32_t mgmt_event, struct net_if *iface)
{
	switch (mgmt_event) {
	case NET_EVENT_WIFI_CONNECT_RESULT:
		handle_wifi_connect_result(cb);
		break;
	default:
		break;
	}
}

void wifi_connect(void)
{
	int nr_tries = 10;
	int ret = 0;

	net_mgmt_init_event_callback(&wifi_shell_mgmt_cb,
				     wifi_mgmt_event_handler,
				     NET_EVENT_WIFI_CONNECT_RESULT);

	net_mgmt_add_event_callback(&wifi_shell_mgmt_cb);

	struct net_if *iface = net_if_get_default();
	static struct wifi_connect_req_params cnx_params = {
		.ssid = CONFIG_SPRINKLER_HTTP_WIFI_SSID,
		.ssid_length = 0,
		.psk = CONFIG_SPRINKLER_HTTP_WIFI_PSK,
		.psk_length = 0,
		.channel = 0,
		.security = WIFI_SECURITY_TYPE_PSK,
	};

	cnx_params.ssid_length = strlen(CONFIG_SPRINKLER_HTTP_WIFI_SSID);
	cnx_params.psk_length = strlen(CONFIG_SPRINKLER_HTTP_WIFI_PSK);

	connected = 0;

	LOG_INF("WIFI try connecting to %s...", CONFIG_SPRINKLER_HTTP_WIFI_SSID);

	/* Let's wait a few seconds to allow the wifi device to be on-line */
	while (nr_tries-- > 0) {
		ret = net_mgmt(NET_REQUEST_WIFI_CONNECT, iface, &cnx_params,
			       sizeof(struct wifi_connect_req_params));
		if (ret == 0) {
			break;
		}

		LOG_INF("Connect request failed %d. Waiting iface be up...", ret);
		k_msleep(500);
	}

	while (connected == 0) {
		k_msleep(100);
	}
}
```

## src/wifi.h
```c
void wifi_connect(void);
```
